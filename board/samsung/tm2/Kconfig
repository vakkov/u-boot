## board/samsung/tm2/Kconfig
```kconfig
if TARGET_TM2

config SYS_BOARD
	default "tm2"
	help
	  TM2 is Exynos5433 SoC based board, Tizen reference board.

config SYS_VENDOR
	default "samsung"

config SYS_CONFIG_NAME
	default "tm2"

endif
```

## configs/tm2_defconfig
```kconfig
CONFIG_ARM=y
# CONFIG_ARM64_SUPPORT_AARCH32 is not set
CONFIG_ARCH_EXYNOS=y
CONFIG_SYS_TEXT_BASE=0x20080000
CONFIG_ARCH_EXYNOS5433=y
CONFIG_SYS_MALLOC_F_LEN=0x2000
CONFIG_IDENT_STRING="\nSamsung Exynos5433 TM2"
CONFIG_SYS_LOAD_ADDR=0x20080000
CONFIG_FIT=y
CONFIG_BOOTDELAY=-2
CONFIG_SYS_CONSOLE_INFO_QUIET=y
# CONFIG_DISPLAY_CPUINFO is not set
CONFIG_HUSH_PARSER=y
# CONFIG_CMD_CONSOLE is not set
# CONFIG_CMD_ELF is not set
# CONFIG_CMD_GO is not set
CONFIG_CMD_THOR_DOWNLOAD=y
# CONFIG_CMD_EXPORTENV is not set
# CONFIG_CMD_IMPORTENV is not set
# CONFIG_CMD_EDITENV is not set
# CONFIG_CMD_SAVEENV is not set
# CONFIG_CMD_ENV_EXISTS is not set
# CONFIG_CMD_DM is not set
# CONFIG_CMD_FLASH is not set
CONFIG_CMD_GPIO=y
CONFIG_CMD_GPT=y
# CONFIG_RANDOM_UUID is not set
CONFIG_CMD_I2C=y
# CONFIG_CMD_LOADB is not set
# CONFIG_CMD_LOADS is not set
CONFIG_CMD_MMC=y
CONFIG_CMD_PART=y
# CONFIG_CMD_SOURCE is not set
# CONFIG_CMD_SETEXPR is not set
# CONFIG_CMD_NET is not set
CONFIG_CMD_FS_GENERIC=y
CONFIG_DEFAULT_DEVICE_TREE="exynos5433-tm2"
# CONFIG_DM_DEVICE_REMOVE is not set
CONFIG_DFU_MMC=y
CONFIG_DM_I2C_GPIO=y
CONFIG_DM_MMC=y
CONFIG_MMC_DW=y
CONFIG_USB=y
CONFIG_USB_DWC3=y
CONFIG_USB_DWC3_GADGET=y
CONFIG_USB_GADGET=y
CONFIG_USB_GADGET_VENDOR_NUM=0x04e8
CONFIG_USB_GADGET_PRODUCT_NUM=0x685D
CONFIG_USB_GADGET_DOWNLOAD=y
CONFIG_USB_FUNCTION_MASS_STORAGE=y
CONFIG_USB_FUNCTION_THOR=y
# CONFIG_SYS_WHITE_ON_BLACK is not set
# CONFIG_EFI_LOADER is not set
```
